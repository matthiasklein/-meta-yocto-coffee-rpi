## conf/bblayers.conf.sample
```bitbake
POKY_BBLAYERS_CONF_VERSION = "2"

BBPATH = "${TOPDIR}"
BSPDIR := "${@os.path.abspath(os.path.dirname(d.getVar('FILE', True)) + '/../..')}"

BBFILES ?= ""
BBLAYERS = " \
  ${BSPDIR}/yocto/poky/meta \
  ${BSPDIR}/yocto/poky/meta-poky \
  \
  ${BSPDIR}/yocto/poky/meta-yocto-bsp \
  \
  ${BSPDIR}/yocto/meta-openembedded/meta-oe \
  ${BSPDIR}/yocto/meta-openembedded/meta-multimedia \
  ${BSPDIR}/yocto/meta-openembedded/meta-filesystems \
  ${BSPDIR}/yocto/meta-openembedded/meta-python \
  ${BSPDIR}/yocto/meta-openembedded/meta-networking \
  \
  ${BSPDIR}/yocto/meta-raspberrypi \
  ${BSPDIR}/yocto/meta-rauc \
  ${BSPDIR}/yocto/meta-qt6 \
  \
  ${BSPDIR}/yocto/meta-distro-coffee \
  ${BSPDIR}/yocto/meta-yocto-coffee-rpi \
"
```

## conf/layer.conf
```bitbake
# We have a conf and classes directory, add to BBPATH
BBPATH .= ":${LAYERDIR}"

# We have recipes-* directories, add to BBFILES
BBFILES += "${LAYERDIR}/recipes-*/*/*.bb \
            ${LAYERDIR}/recipes-*/*/*.bbappend"

BBFILE_COLLECTIONS += "meta-yocto-coffee-rpi"
BBFILE_PATTERN_meta-yocto-coffee-rpi= "^${LAYERDIR}/"
BBFILE_PRIORITY_meta-yocto-coffee-rpi = "6"

LAYERDEPENDS_meta-yocto-coffee-rpi = "core"
LAYERSERIES_COMPAT_meta-yocto-coffee-rpi = "kirkstone"
```

## conf/local.conf.sample
```bitbake
#MACHINE ??= "raspberrypi3-64"
#MACHINE ??= "raspberrypi0-2w-64"
MACHINE ??= "raspberrypi4-64"

WKS_FILE ?= "sdimage-coffee.wks"

DISTRO_FEATURES:append = " rauc"
RAUC_KEYRING_FILE="${THISDIR}/../../../meta-distro-coffee/openssl-ca/dev/ca.cert.pem"
RAUC_KEY_FILE="${THISDIR}/../../../meta-distro-coffee/openssl-ca/dev/private/development-1.key.pem"
RAUC_CERT_FILE="${THISDIR}/../../../meta-distro-coffee/openssl-ca/dev/development-1.cert.pem"

DL_DIR ?= "${BSPDIR}/downloads"
SSTATE_DIR ?= "${BSPDIR}/sstate-cache"
INHERIT += "rm_work"

DISTRO ?= "coffee"
PACKAGE_CLASSES ?= "package_ipk"

EXTRA_IMAGE_FEATURES ?= "debug-tweaks"
USER_CLASSES ?= "buildstats"
PATCHRESOLVE = "noop"

## meta-raspberrypi specific options
# Needed on RaspberryPi 0 Wifi and 3 to enable UART console
ENABLE_UART = "1"
RPI_USE_U_BOOT = "1"

IMAGE_FSTYPES ?= "tar.bz2 wic.gz wic.bmap"

BB_DISKMON_DIRS ??= "\
    STOPTASKS,${TMPDIR},1G,100K \
    STOPTASKS,${DL_DIR},1G,100K \
    STOPTASKS,${SSTATE_DIR},1G,100K \
    STOPTASKS,/tmp,100M,100K \
    HALT,${TMPDIR},100M,1K \
    HALT,${DL_DIR},100M,1K \
    HALT,${SSTATE_DIR},100M,1K \
    HALT,/tmp,10M,1K"

CONF_VERSION = "2"
```

## wic/sdimage-coffee.wks
```
# The partitionging scheme provides:
# * a bootloader partition with the u-boot environment in a file and the Raspberry Pi boot files
# * two root file system partitions for atomic updates
# * a common data partition

# Note: The fstab is modified via the recipe base-files_%.bbappend, because the modification must also be included in the RAUC bundle.
#       This would not be the case if the fstab was modified by WIC.

part --align 4096 --size 20          --fstype=vfat --active                             --label uboot     --source bootimg-partition
part --align 1024 --extra-space 500M --fstype=ext4 --mkfs-extraopts="-O ^metadata_csum" --label coffeea   --source rootfs
part --align 1024 --extra-space 500M --fstype=ext4 --mkfs-extraopts="-O ^metadata_csum" --label coffeeb   --source rootfs
part --align 1024 --fixed-size 1000M --fstype=ext4                                      --label workspace
```
